## Documentation/devicetree/bindings/iio/light/rohm,rpr0400.yaml
```yaml
# SPDX-License-Identifier: (GPL-2.0-only OR BSD-2-Clause)
%YAML 1.2
---
$id: http://devicetree.org/schemas/iio/light/rohm,rpr0400.yaml#
$schema: http://devicetree.org/meta-schemas/core.yaml#

title: ROHM RPR-0400 ambient light and proximity sensor

maintainers:
  - Custom Firmware <gabin278@gmail.com>

description:
  RPR-0400 is an I2C ambient light and proximity sensor. The ambient
  light block has two photodiode channels, one sensitive to visible and
  infrared light and one to infrared only. An interrupt output can
  signal proximity and ambient light threshold events.

properties:
  compatible:
    const: rohm,rpr0400

  reg:
    maxItems: 1

  interrupts:
    maxItems: 1

  vdd-supply: true

required:
  - compatible
  - reg
  - vdd-supply

additionalProperties: false

examples:
  - |
    #include <dt-bindings/interrupt-controller/irq.h>
    i2c {
        #address-cells = <1>;
        #size-cells = <0>;

        light-sensor@39 {
            compatible = "rohm,rpr0400";
            reg = <0x39>;
            interrupt-parent = <&gpio>;
            interrupts = <2 IRQ_TYPE_LEVEL_LOW>;
            vdd-supply = <&vdd>;
        };
    };
...
```

## Documentation/devicetree/bindings/media/mediatek,mt6572-mdp.yaml
```yaml
# SPDX-License-Identifier: (GPL-2.0-only OR BSD-2-Clause)
%YAML 1.2
---
$id: http://devicetree.org/schemas/media/mediatek,mt6572-mdp.yaml#
$schema: http://devicetree.org/meta-schemas/core.yaml#

title: MediaTek MT6572 Media Data Path

maintainers:
  - Custom Firmware <gabin278@gmail.com>

description:
  The MT6572 Media Data Path (MDP) engines convert video frames from memory
  to memory. MDP_RDMA reads a frame, RSZ scales it, TDSHP sharpens it, WROT
  rotates it and converts YUV to RGB on the way back to memory, and MDP_WDMA
  writes it without rotation. The CPU programs the engines directly, and the
  display mutex starts them together.

properties:
  compatible:
    enum:
      - mediatek,mt6572-mdp-rdma
      - mediatek,mt6572-mdp-rsz
      - mediatek,mt6572-mdp-tdshp
      - mediatek,mt6572-mdp-wdma
      - mediatek,mt6572-mdp-wrot

  reg:
    maxItems: 1

  interrupts:
    maxItems: 1

  clocks:
    maxItems: 1

  power-domains:
    maxItems: 1

  resets:
    maxItems: 1

  iommus:
    minItems: 1
    maxItems: 3

required:
  - compatible
  - reg
  - interrupts
  - clocks
  - power-domains
  - resets

allOf:
  - if:
      properties:
        compatible:
          enum:
            - mediatek,mt6572-mdp-rdma
            - mediatek,mt6572-mdp-wdma
    then:
      properties:
        iommus:
          maxItems: 1
      required:
        - iommus

  - if:
      properties:
        compatible:
          const: mediatek,mt6572-mdp-wrot
    then:
      properties:
        iommus:
          items:
            - description: luma or RGB output
            - description: Cb or CbCr output
            - description: Cr output
      required:
        - iommus

  - if:
      properties:
        compatible:
          enum:
            - mediatek,mt6572-mdp-rsz
            - mediatek,mt6572-mdp-tdshp
    then:
      properties:
        iommus: false

additionalProperties: false

examples:
  - |
    #include <dt-bindings/clock/mediatek,mt6572-clk.h>
    #include <dt-bindings/interrupt-controller/arm-gic.h>
    #include <dt-bindings/interrupt-controller/irq.h>
    #include <dt-bindings/memory/mediatek,mt6572-memory-port.h>
    #include <dt-bindings/power/mediatek,mt6572-power-controller.h>
    #include <dt-bindings/reset/mediatek,mt6572-resets.h>

    rdma@14001000 {
        compatible = "mediatek,mt6572-mdp-rdma";
        reg = <0x14001000 0x1000>;
        interrupts = <GIC_SPI 97 IRQ_TYPE_LEVEL_LOW>;
        clocks = <&mmsys CLK_MM_DISP_MDP_RDMA>;
        power-domains = <&spm MT6572_POWER_DOMAIN_DIS>;
        resets = <&mmsys MT6572_MM_RST_B_MDP_RDMA>;
        iommus = <&iommu M4U_PORT_MDP_RDMA>;
    };

    rsz@14002000 {
        compatible = "mediatek,mt6572-mdp-rsz";
        reg = <0x14002000 0x1000>;
        interrupts = <GIC_SPI 94 IRQ_TYPE_LEVEL_LOW>;
        clocks = <&mmsys CLK_MM_DISP_MDP_RSZ0>;
        power-domains = <&spm MT6572_POWER_DOMAIN_DIS>;
        resets = <&mmsys MT6572_MM_RST_B_MDP_RSZ0>;
    };

    wrot@14005000 {
        compatible = "mediatek,mt6572-mdp-wrot";
        reg = <0x14005000 0x1000>;
        interrupts = <GIC_SPI 95 IRQ_TYPE_LEVEL_LOW>;
        clocks = <&mmsys CLK_MM_DISP_MDP_WROT>;
        power-domains = <&spm MT6572_POWER_DOMAIN_DIS>;
        resets = <&mmsys MT6572_MM_RST_B_MDP_WROT>;
        iommus = <&iommu M4U_PORT_MDP_ROTO>,
                 <&iommu M4U_PORT_MDP_ROTCO>,
                 <&iommu M4U_PORT_MDP_ROTVO>;
    };
```

## Documentation/devicetree/bindings/power/supply/mediatek,mt6323-charger.yaml
```yaml
# SPDX-License-Identifier: (GPL-2.0-only OR BSD-2-Clause)
%YAML 1.2
---
$id: http://devicetree.org/schemas/power/supply/mediatek,mt6323-charger.yaml#
$schema: http://devicetree.org/meta-schemas/core.yaml#

title: MediaTek MT6323 PMIC linear charger

maintainers:
  - Custom Firmware <gabin278@gmail.com>

description:
  The MT6323 PMIC charges a single-cell Li-ion battery from the USB port
  through an external pass transistor. It regulates the charge current,
  sensed across a resistor between the transistor and the battery, and the
  battery voltage in hardware.

allOf:
  - $ref: power-supply.yaml#

properties:
  compatible:
    const: mediatek,mt6323-charger

  io-channels:
    minItems: 2
    items:
      - description: AUXADC ISENSE, the charger side of the sense resistor
      - description: AUXADC BATSNS, the battery side of the sense resistor
      - description: Battery temperature, in millidegrees Celsius

  io-channel-names:
    minItems: 2
    items:
      - const: isense
      - const: batsns
      - const: temp

  monitored-battery:
    description:
      The battery. Its constant-charge-voltage-max-microvolt and
      constant-charge-current-max-microamp are required, and
      operating-range-celsius when a temperature channel is given.

  shunt-resistor-micro-ohms:
    description: The charge current sense resistor.

required:
  - compatible
  - io-channels
  - io-channel-names
  - monitored-battery
  - shunt-resistor-micro-ohms

unevaluatedProperties: false

examples:
  - |
    #include <dt-bindings/iio/adc/mediatek,mt6323-auxadc.h>

    charger {
        compatible = "mediatek,mt6323-charger";
        io-channels = <&mt6323_adc MT6323_AUXADC_ISENSE>,
                      <&mt6323_adc MT6323_AUXADC_BATSNS>,
                      <&battery_ntc 0>;
        io-channel-names = "isense", "batsns", "temp";
        monitored-battery = <&battery>;
        shunt-resistor-micro-ohms = <200000>;
    };
```

## Documentation/devicetree/bindings/sound/mediatek,mt6572-afe.yaml
```yaml
# SPDX-License-Identifier: (GPL-2.0-only OR BSD-2-Clause)
%YAML 1.2
---
$id: http://devicetree.org/schemas/sound/mediatek,mt6572-afe.yaml#
$schema: http://devicetree.org/meta-schemas/core.yaml#

title: MediaTek MT6572 AFE PCM controller

maintainers:
  - Custom Firmware <gabin278@gmail.com>

description:
  The Audio Front-End (AFE) of the MediaTek MT6572 SoC. It provides the DL1
  playback memif (a DMA engine streaming from the on-chip audio SRAM) and the
  digital side of the serial audio link to the MT6323 PMIC analog codec.

properties:
  compatible:
    const: mediatek,mt6572-audio

  clocks:
    maxItems: 1

  clock-names:
    const: audio

  interrupts:
    maxItems: 1

  iram:
    $ref: /schemas/types.yaml#/definitions/phandle
    description: on-chip audio SRAM used for the DL1 playback buffers.

required:
  - compatible
  - clocks
  - clock-names
  - interrupts
  - iram

additionalProperties: false
```

## Documentation/devicetree/bindings/sound/mediatek,mt6572-mt6323.yaml
```yaml
# SPDX-License-Identifier: (GPL-2.0-only OR BSD-2-Clause)
%YAML 1.2
---
$id: http://devicetree.org/schemas/sound/mediatek,mt6572-mt6323.yaml#
$schema: http://devicetree.org/meta-schemas/core.yaml#

title: MediaTek MT6572 sound card with the MT6323 PMIC codec

maintainers:
  - Custom Firmware <gabin278@gmail.com>

description:
  The machine-level sound card binding the MT6572 AFE platform to the MT6323
  PMIC analog codec, with optional headphone-jack detection and an external
  speaker amplifier.

properties:
  compatible:
    const: mediatek,mt6572-mt6323-sound

  mediatek,platform:
    $ref: /schemas/types.yaml#/definitions/phandle
    description: phandle to the MT6572 AFE platform.

  mediatek,speaker-amp:
    $ref: /schemas/types.yaml#/definitions/phandle
    description:
      Optional external speaker amplifier (e.g. simple-audio-amplifier),
      registered as an aux device and fed from the codec headphone output.

  hp-det-gpios:
    maxItems: 1
    description: Optional headphone-jack plug-detect GPIO (high = inserted).

required:
  - compatible
  - mediatek,platform

additionalProperties: false
```

## drivers/media/platform/mediatek/mt6572-mdp/Kconfig
```kconfig
# SPDX-License-Identifier: GPL-2.0-only
config VIDEO_MEDIATEK_MDP_MT6572
	tristate "MediaTek MT6572 MDP scaler/rotator"
	depends on V4L_MEM2MEM_DRIVERS
	depends on VIDEO_DEV
	depends on ARCH_MEDIATEK || COMPILE_TEST
	depends on MTK_IOMMU_V1 || COMPILE_TEST
	select VIDEOBUF2_DMA_CONTIG
	select VIDEOBUF2_DMA_SG
	select V4L2_MEM2MEM_DEV
	help
	  V4L2 memory-to-memory driver for the MDP block of MediaTek
	  MT6572 SoCs: colour conversion, scaling and rotation of video
	  frames, programmed by the CPU without a co-processor.

	  To compile this driver as a module, choose M here: the
	  module will be called mt6572-mdp.
```
